## app/Kconfig
```kconfig
# Kconfig - Config options for EC FW

mainmenu "EC firmware application"

menu "EC firmware version"

config APP_FW_VERSION_MAJOR
	int "Firmware major version"
	range 0 255
	default 0

config APP_FW_VERSION_MINOR
	int "Firmware minor version"
	range 0 255
	default 0

config APP_FW_VERSION_PATCH
	int "Firmware patch (test) version"
	range 0 255
	default 0

endmenu

menu "EC optional features"
rsource "../service/Kconfig"
endmenu

menu "Zephyr OS options"
source "Kconfig.zephyr"
endmenu
```

## app/Kconfig.sysbuild
```kconfig
# Copyright (c) 2024 Nordic Semiconductor ASA
# SPDX-License-Identifier: Apache-2.0

source "${ZEPHYR_BASE}/share/sysbuild/Kconfig"
```

## app/sample.yaml
```yaml
sample:
  name: I3C loopback sample
tests:
  sample.drivers.i3c.loopback:
    tags: i3c
```

## app/service/Kconfig
```kconfig
orsource "acpi/Kconfig"
orsource "sci/Kconfig"
orsource "fan/Kconfig"
orsource "power/Kconfig"
orsource "soccp/Kconfig"
orsource "thermal/Kconfig"
```

## app/service/acpi/Kconfig
```kconfig
menuconfig ACPI_SERVICE
	bool "ACPI Service"
	default y
	help
	  Enable the ACPI service to handle Host ACPI commands and SCI events.

if ACPI_SERVICE
module = ACPI
module-str = acpi
source "subsys/logging/Kconfig.template.log_config"

config ACPI_SHELL
	bool "ACPI Shell commands"
	depends on SHELL
	default y
	help
	  Enable shell commands for the ACPI service.
endif
```

## app/service/keyboard/Kconfig
```kconfig
menuconfig KEYBOARD_SERVICE
	bool "Keyboard Service"
	default y
	help
	  Enable the Keyboard service for HID 6KRO report management.

if KEYBOARD_SERVICE
module = KEYBOARD
module-str = keyboard
source "subsys/logging/Kconfig.template.log_config"

config KEYBOARD_SHELL
	bool "Keyboard Shell commands"
	depends on SHELL
	default y
	help
	  Enable shell commands for the Keyboard service.
endif
```

## app/service/sci/Kconfig
```kconfig
module = SCI
module-str = sci
source "subsys/logging/Kconfig.template.log_config"

config ACPI_SCI_QUEUE_LEN
	int "SCI event queue length"
	range 1 64
	default 16
	help
	  Number of SCI events that can be pending in the queue while waiting to
	  be notified to the host. Events are dropped once the queue is full.

config ACPI_SCI_TIMEOUT_MS
	int "SCI notification timeout (ms)"
	range 1 10000
	default 100
	help
	  Time the host is given to read a notified SCI event with cmd 0x05 after
	  the ACPI interrupt line is asserted. When it expires the line is
	  deasserted, but the pending SCI event is retained.

config SCI_SHELL
	bool "SCI Shell commands"
	depends on SHELL
	default y
	help
	  Enable shell commands for the SCI service.
```

## bootloader/service/acpi/Kconfig
```kconfig
menuconfig ACPI_SERVICE
	bool "ACPI Service"
	default y
	help
	  Enable the ACPI service to handle Host ACPI commands and SCI events.

if ACPI_SERVICE
module = ACPI
module-str = acpi
source "subsys/logging/Kconfig.template.log_config"

config ACPI_SCI_QUEUE_LEN
	int "SCI event queue length"
	range 1 64
	default 16
	help
	  Number of SCI events that can be pending in the queue while waiting to
	  be notified to the host. Events are dropped once the queue is full.

config ACPI_SCI_TIMEOUT_MS
	int "SCI notification timeout (ms)"
	range 1 10000
	default 100
	help
	  Time the host is given to read a notified SCI event with cmd 0x05 after
	  the ACPI interrupt line is asserted. When it expires the event is
	  dropped and the next queued event, if any, is notified instead.

config ACPI_SHELL
	bool "ACPI Shell commands"
	depends on SHELL
	default y
	help
	  Enable shell commands for the ACPI service.
endif
```

## modules/app/boards/microchip/ec_card/Kconfig.ec_card
```kconfig
# Copyright (c) 2025 Microchip Technology Inc.
# SPDX-License-Identifier: Apache-2.0

config BOARD_EC_CARD
	select SOC_MEC1753_QSZ if BOARD_EC_CARD_MEC1753_QSZ
	select SOC_MEC172X_NSZ if BOARD_EC_CARD_MEC172X_NSZ
	select HAS_PM
```

## modules/app/boards/microchip/ec_card/board.yml
```yaml
board:
  name: ec_card
  # For zephyr 3.7
  # full_name: Microchip EC Card
  # For zephyr 3.7 end
  vendor: microchip
  socs:
  - name: mec1753_qsz
  - name: mec172x_nsz
```

## modules/app/boards/microchip/qc_module/qc_module_defconfig
```kconfig
# Copyright (c) 2025, Microchip Technology Inc.
# SPDX-License-Identifier: Apache-2.0
#

# For zephyr 3.7
CONFIG_RTOS_TIMER=y
CONFIG_PINCTRL=y
# For zephyr 3.7 end

CONFIG_CLOCK_CONTROL=y
CONFIG_GPIO=y
CONFIG_SERIAL=y
CONFIG_CONSOLE=y
CONFIG_UART_CONSOLE=y
```

## modules/app/dts/bindings/gpio-users.yaml
```yaml
description: |
  This allows you to define a gpio node.

  Here is an example which defines gpio in the node /pins:

  / {
  	pins {
  		compatible = "gpio-users";
  		pwr_btn0: pwr_btn0 {
  			gpios = <&gpio0 1 GPIO_ACTIVE_LOW>;
  		};
  	};
  };

compatible: "gpio-users"

child-binding:
  description: GPIO user child node
  properties:
    gpios:
      type: phandle-array
      required: true
    label:
      type: string
      description: |
        Description of the gpio user.
```

## service/Kconfig
```kconfig
config APP_BOOTLOADER
	bool "EC bootloader"
	default n
	help
	  Build the shared drivers and services for the EC bootloader. Enables
	  bootloader-only components (flash service, image validation, firmware
	  update commands) and leaves out app-only services.

orsource "acpi/Kconfig"

if !APP_BOOTLOADER
orsource "sci/Kconfig"
orsource "fan/Kconfig"
orsource "power/Kconfig"
orsource "soccp/Kconfig"
orsource "thermal/Kconfig"
endif
```

## service/fan/Kconfig
```kconfig
menuconfig FAN_SERVICE
	bool "Fan Service"
	default y
	help
	  Enable the Fan service for thermal management and fan control.

if FAN_SERVICE
module = FAN
module-str = fan
source "subsys/logging/Kconfig.template.log_config"

config FAN_SHELL
	bool "Fan Shell commands"
	depends on SHELL
	default y
	help
	  Enable shell commands for the Fan service.
endif
```

## service/power/Kconfig
```kconfig
menuconfig POWER_SERVICE
	bool "Power Service"
	default y
	help
	  Enable the Power service for system power state management.

if POWER_SERVICE
module = POWER
module-str = power
source "subsys/logging/Kconfig.template.log_config"

config POWER_SHELL
	bool "Power Shell commands"
	depends on SHELL
	default y
	help
	  Enable shell commands for the Power service.
endif
```

## service/sci/Kconfig
```kconfig
menuconfig SCI_SERVICE
	bool "SCI Service"
	default y
	help
	  Enable queueing and host notification of System Control Interrupt events.

if SCI_SERVICE
module = SCI
module-str = sci
source "subsys/logging/Kconfig.template.log_config"

config ACPI_SCI_QUEUE_LEN
	int "SCI event queue length"
	range 1 64
	default 16
	help
	  Number of SCI events that can be pending while waiting for host readback.

config ACPI_SCI_TIMEOUT_MS
	int "SCI notification timeout (ms)"
	range 1 10000
	default 100
	help
	  Time allowed for the host to read an announced SCI event before it is
	  dropped and the next queued event is notified.

config SCI_SHELL
	bool "SCI Shell commands"
	depends on SHELL
	default y
	help
	  Enable shell commands for the SCI service.
endif
```

## service/soccp/Kconfig
```kconfig
menuconfig SOCCP_SERVICE
	bool "SoCCP Service"
	default y
	help
	  Enable the SoCCP (System on Chip Control Protocol) service.

if SOCCP_SERVICE
module = SOCCP
module-str = soccp
source "subsys/logging/Kconfig.template.log_config"

config SOCCP_SHELL
	bool "SoCCP Shell commands"
	depends on SHELL
	default y
	help
	  Enable shell commands for the SoCCP service.
endif
```

## service/thermal/Kconfig
```kconfig
menuconfig THERMAL_SERVICE
	bool "Thermal Service"
	default y
	help
	  Enable the Thermal service for sensor monitoring and threshold management.

if THERMAL_SERVICE
module = THERMAL
module-str = thermal
source "subsys/logging/Kconfig.template.log_config"

config THERMAL_SHELL
	bool "Thermal Shell commands"
	depends on SHELL
	default y
	help
	  Enable shell commands for the Thermal service.
endif
```

## tools/west.yml
```yaml
manifest:
  version: "0.12"

  defaults:
    remote: zephyrproject-rtos

  remotes:
    - name: zephyrproject-rtos
      url-base: https://github.com/zephyrproject-rtos
    - name: MicrochipTech
      url-base: https://github.com/MicrochipTech

  projects:
    - name: zephyr-rtos
      repo-path: zephyr.git
      path: zephyr-rtos
      remote: zephyrproject-rtos
      revision: v3.7.1
      clone-depth: 1
      import:
        name-allowlist:
          - cmsis
          - hal_microchip

    - name: app
      path: modules/app

  self:
    path: tool
```
